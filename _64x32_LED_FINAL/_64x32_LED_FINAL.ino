// 192x32 Uno LED panel driver
// Fast Clock Mod
// 3/4/2019 by Bob Davis

// #define A   A0  // Port D assignments
// #define B   A1
// #define C   A2
// #define D   A3
// #define E   A4
#define CLK 8 // Port B assignments   
#define OE  9
#define LAT 10

int C12[16] = {0,1,1,1,1,1,1,1,1,1,1,1,1,1,1,1};
int C13[16] = {0,0,0,0,0,0,0,0,0,1,0,0,0,0,0,0};

#define MaxLed 192
byte BGC1=0x04;  // Background
byte FGC1=0x1C;  // Foreground
byte BGC2=0x20;  // Background
byte FGC2=0xE0;  // Foreground

#define PIXEL_PORT PORTD  // Port the pixels are connected to
#define PIXEL_DDR  DDRD   // D2-D7
#define ROW_PORT   PORTC  // Port the rows are connected to
#define ROW_DDR    DDRC   // A0-A5
#define CLK_PORT   PORTB  // Port the Clock/LE/OE are connected to
#define CLK_DDR    DDRB   // D8-D13

char text1[]="ARDUINO UNO RUNNING              ";
char text2[]="THREE 64X32 LED PANELS           ";

// This font from http://sunge.awardspace.com/glcd-sd/node4.html
byte font[][7] = {
0x00,0x00,0x00,0x00,0x00,0x00,0x00, // ascii 32 
0x00,0x00,0xfa,0x00,0x00,0x00,0x00, // !
0x00,0xe0,0x00,0xe0,0x00,0x00,0x00, // "
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0x86,0x8a,0x92,0xa2,0xc2,0x00,0x00,  // Z
};

void setup() {
  PIXEL_DDR = 0xFF;  // Set all pixel pins to output
  ROW_DDR = 0xFF;    // Set all row pins to output
  CLK_DDR = 0xFF;    // Set all CLK/LE/OE pins to output

  digitalWrite (OE, LOW); // Display on
  digitalWrite (LAT, LOW);
  digitalWrite (CLK, LOW);

  // Send Data to control register 11
  for (int l=0; l<MaxLed; l++){
    int y=l%16;
    PORTD = 0x00;
    if (C12[y]==1) PORTD=0xFC;
      if (l<MaxLed-12){ PORTB=1; PORTB=0; }
      else{ PORTB=7; PORTB=6; }
    }
  digitalWrite (LAT, LOW);
  
  // Send Data to control register 12 
  for (int l=0; l<MaxLed; l++){
    int y=l%16;
    PORTD = 0x00;
    if (C13[y]==1) PORTD=0xFC;
      if (l<MaxLed-13){ PORTB=1; PORTB=0; }
      else{ PORTB=7; PORTB=6; }
    }
  digitalWrite (LAT, LOW);
}

void loop() {
  for (int c=0; c<600; c++){
    if (c > 000){BGC1=0x04; BGC2=0x20;}
    if (c > 100){BGC1=0x00; BGC2=0x00;}
    if (c > 200){BGC1=0x08; BGC2=0x40;}
    if (c > 300){BGC1=0x00; BGC2=0x00;}
    if (c > 400){BGC1=0x10; BGC2=0x80;}
    if (c > 500){BGC1=0x00; BGC2=0x00;}
    // Select the Row
    for (int r=0; r<16; r++){
      for (int l=0; l<MaxLed; l++){
        int y=l%8; // remainder after division
        int pd1 = BGC1;
        int pd2 = BGC2;
        if (y < 6){
          if ((font[text1[l/8]-32][y] >> 8-r/2) & 0x01==1) pd1=FGC1; 
          if ((font[text2[l/8]-32][y] >> 8-r/2) & 0x01==1) pd2=FGC2; 
          PORTD=pd1+pd2;
        }
        if (l<MaxLed-3) {PORTB=1; PORTB=0;}
        else {PORTB=7; PORTB=6;}
      }
      digitalWrite (LAT, LOW);
      PORTC=r;  // Update row
      digitalWrite (OE, LOW);  // Display on
    }
  }
}
